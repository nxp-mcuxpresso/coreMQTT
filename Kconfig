## Kconfig
```kconfig
#
# Copyright 2024-2026 NXP
#
# SPDX-License-Identifier: BSD-3-Clause
#

menuconfig MCUX_COMPONENT_middleware.freertos.coremqtt
    bool "coremqtt"
    default n
    help
        Client implementation of the MQTT 3.1.1 specification for embedded
    
config MCUX_COMPONENT_middleware.freertos.coremqtt.template
    bool "template"
    depends on MCUX_COMPONENT_middleware.freertos.coremqtt
    select MCUX_COMPONENT_middleware.iot_reference.logging
```
